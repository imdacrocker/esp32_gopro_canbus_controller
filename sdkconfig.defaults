## sdkconfig.defaults
```kconfig
# Flash configuration
CONFIG_ESPTOOLPY_FLASHSIZE_8MB=y
CONFIG_ESPTOOLPY_FLASHSIZE="8MB"

CONFIG_PARTITION_TABLE_CUSTOM=y
CONFIG_PARTITION_TABLE_CUSTOM_FILENAME="partitions.csv"
CONFIG_PARTITION_TABLE_FILENAME="partitions.csv"

# Decrease brownout sensitivity from 7 to 5
CONFIG_ESP_BROWNOUT_DET_LVL_SEL_5=y
CONFIG_ESP_BROWNOUT_DET_LVL=5

# Increase the CPU clock
#CONFIG_ESP_DEFAULT_CPU_FREQ_MHZ_240=y
#CONFIG_ESP_DEFAULT_CPU_FREQ_MHZ=240

CONFIG_ESP_WIFI_RX_IRAM_OPT=y
CONFIG_TWAI_ISR_IN_IRAM=y

CONFIG_ESP_SYSTEM_EVENT_TASK_STACK_SIZE=4096

# Needed for the HTTP posting
CONFIG_HTTPD_MAX_REQ_HDR_LEN=1024

CONFIG_LWIP_MAX_SOCKETS=16

# Bluetooth - NimBLE only (no Bluedroid)
CONFIG_BT_ENABLED=y
CONFIG_BT_NIMBLE_ENABLED=y
CONFIG_BT_BLUEDROID_ENABLED=n
CONFIG_BT_NIMBLE_NVS_PERSIST=y
CONFIG_BT_NIMBLE_MAX_BONDS=4
CONFIG_BT_NIMBLE_LOG_LEVEL_WARNING=y
#CONFIG_BT_CTRL_DFT_TX_POWER_LEVEL_P20=y
```
